## sources/meta-custom/conf/machine/imx6qcustom-emmc.conf
```bitbake
#@TYPE: Machine
#@NAME: Freescale i.MX6Q SABRE Smart Device
#@SOC: i.MX6Q
#@DESCRIPTION: Machine configuration for Freescale i.MX6Q SABRE Smart Device
#@MAINTAINER: Otavio Salvador <otavio@ossystems.com.br>
#@MAINTAINER: purvi.billore@gmail.com

require conf/machine/include/imx6sabresd-common.inc

SOC_FAMILY = "mx6:mx6q"

KERNEL_DEVICETREE = "imx6q-sabresd-ldo.dtb"

KERNEL_IMAGETYPE = "zImage"

PREFERRED_PROVIDER_u-boot = "u-boot-fslc-custom"
PREFERRED_PROVIDER_virtual/bootloader = "u-boot-fslc-custom"
PREFERRED_PROVIDER_virtual/kernel = "linux-fslc-imx-custom"

UBOOT_CONFIG ??= "sd"
UBOOT_CONFIG[sd] = "mx6qsabresd_config,sdcard"
UBOOT_CONFIG[sata] = "mx6qsabresd_sata_config"
UBOOT_CONFIG[mfgtool] = "mx6qsabresd_config"

SERIAL_CONSOLE = "115200 ttymxc0"
```
